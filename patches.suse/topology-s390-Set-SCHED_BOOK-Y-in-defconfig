## patches.suse/topology-s390-Set-SCHED_BOOK-Y-in-defconfig
```kconfig
Subject: [S390] topology: Set CONFIG_SCHED_BOOK=y in arch/s390/defconfig
From: Mike Galbraith <mgalbraith@suse.de>
Date: Thu Jun 16 09:01:46 CEST 2011
Patch-mainline: commit ac5fa22fd4f27376e4ec41b44279c9992322d7ce
References: FATE#311860, bnc#698524

Enable BOOK domain handling by default.

Signed-off-by: Mike Galbraith <mgalbraith@suse.de>
---
 arch/s390/defconfig |    1 +
 1 file changed, 1 insertion(+)

Index: linux-2.6.32-SLE11-SP2/arch/s390/defconfig
===================================================================
--- linux-2.6.32-SLE11-SP2.orig/arch/s390/defconfig
+++ linux-2.6.32-SLE11-SP2/arch/s390/defconfig
@@ -182,6 +182,7 @@ CONFIG_64BIT=y
 CONFIG_SMP=y
 CONFIG_NR_CPUS=32
 CONFIG_HOTPLUG_CPU=y
+CONFIG_SCHED_BOOK=y
 CONFIG_COMPAT=y
 CONFIG_SYSVIPC_COMPAT=y
 CONFIG_AUDIT_ARCH=y
```
